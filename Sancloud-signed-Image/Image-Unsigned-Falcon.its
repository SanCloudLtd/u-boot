## Sancloud-signed-Image/Image-Unsigned-Falcon.its
```
/dts-v1/;

/ {
    description = "Beaglebone black";
    #address-cells = <1>;
    images {
        kernel {
            description = "vmlinuz-5.10.168-ti-r79";
            data = /incbin/("./vmlinuz-5.10.168-ti-r79");
            type = "kernel";
            arch = "arm";
            os = "linux";
            load =  <0x89000000>;
            entry = <0x89000000>;
            compression = "none";
            hash{
                algo = "sha256";
            };

        };
        args {
            description = "FALCON BOOT ARGS";
            data = /incbin/("./falconargs-BBE-Light-SD");
            type = "flat_dt";
            arch = "arm";
            os = "linux";
            compression = "none";
            load =<0x8f81f000>;
            entry = <0x8f81f000>;
            hash{
                algo = "sha256";
            };
        };
    };
    configurations {
        default = "SanCloud-Secure";
        SanCloud-boneenhanced {
            description = "";
            kernel = "kernel";
            fdt = "args";
            compatible ="sancloud,am335x-boneenhanced";
            signature{
                algo = "sha256,rsa2048";
                key-name-hint = "conf";
                sign-images = "fdt", "kernel";
            };
        };
        SanCloud-Secure {
            description = "";
            kernel = "kernel";
            fdt = "args";
            signature{
                algo = "sha256,rsa2048";
                key-name-hint = "conf";
                sign-images = "fdt", "kernel";
            };
        };
    };
};
```

## Sancloud-signed-Image/NotSignFalcom.its
```
/dts-v1/;

/ {
    description = "Beaglebone black";
    #address-cells = <1>;
    images {
        kernel {
            description = "vmlinuz-5.10.168-ti-r79";
            data = /incbin/("./vmlinuz-5.10.168-ti-r79");
            type = "kernel";
            arch = "arm";
            os = "linux";
            load =  <0x89000000>;
            entry = <0x89000000>;
            compression = "none";
        };
        args {
            description = "FALCON BOOT ARGS";
            data = /incbin/("./falconargs");
            type = "flat_dt";
            arch = "arm";
            os = "linux";
            compression = "none";
            load =<0x8f81f000>;
            entry = <0x8f81f000>;
        };
    };
    configurations {
        default = "SanCloud-None-Secure";
        SanCloud-None-Secure {
            description = "";
            kernel = "kernel";
            fdt = "args";
        };
    };
};
```

## Sancloud-signed-Image/NotSigned.its
```
/dts-v1/;

/ {
    description = "Beaglebone black";
    #address-cells = <1>;
    images {
        kernel {
            description = "vmlinuz-5.10.168-ti-r79";
            data = /incbin/("./vmlinuz-5.10.168-ti-r79");
            type = "kernel";
            arch = "arm";
            os = "linux";
            load =  <0x89000000>;
            entry = <0x89000000>;
            compression = "none";
        };
        main_fdt {
            description = "am335x-sancloud-bbe-lite.dtb";
            data = /incbin/("./am335x-sancloud-bbe-lite.dtb");
            type = "flat_dt";
            arch = "arm";
            os = "linux";
            compression = "none";
            load =<0x88000000>;
        };
        fdt-ADC {
            description = "BB-ADC-00A0.dtbo";
            data = /incbin/("./BB-ADC-00A0.dtbo");
            type = "flat_dt";
            arch = "arm";
            os = "linux";
            compression = "none";
            load =<0x88f00000>;
        };
        fdt-eMMC1 {
            description = "BB-BONE-eMMC1-01-00A0.dtbo";
            data = /incbin/("./BB-BONE-eMMC1-01-00A0.dtbo");
            type = "flat_dt";
            arch = "arm";
            os = "linux";
            compression = "none";
            load =<0x88f00000>;
        };
        fdt-SPI {
            description = "BB-SPIDEV0-00A0.dtbo";
            data = /incbin/("./BB-SPIDEV0-00A0.dtbo");
            type = "flat_dt";
            os = "linux";
            arch = "arm";
            compression = "none";
            load =<0x88f00000>;
        };
        initrd {
            description = "Initrd";
            data = /incbin/("./initrd.img-5.10.168-ti-r79");
            type = "ramdisk";
            arch = "arm";
            os = "linux";
            load =<0x88080000>;
            entry=<0x88080000>;
            compression = "none";

        };
    };
    configurations {
        default = "KERNEL_ONLY";
        KERNEL_ONLY{
            description = "LOAD DEBEIAN KERNEL";
            kernel = "kernel";
            fdt = "main_fdt";
            #ramdisk = "initrd";
        };
        ADC {
            description = "ADC support FDT";
            fdt ="fdt-ADC";
        };
        SPI {
            description = "SPI support FDT";
            fdt ="fdt-SPI";
        };
        eMMC1 {
            description = "eMMC1 support FDT";
            fdt ="fdt-eMMC1";
        };
     
    };
};
```

## Sancloud-signed-Image/Recovery-FitImageSigned.its
```
/dts-v1/;

/ {
    description = "Beaglebone black";
    #address-cells = <1>;
    images {
        kernel-1 {
            description = "Image";
            data = /incbin/("./FIT_SourceFiles/Recover-Image.gz");
            type = "kernel";
            arch = "arm64";
            os = "linux";
            load =  <0x82000000>;
            entry = <0x82000000>;
            compression = "gzip";
            hash-1 {
                algo = "sha512";
            };
            signature-1 {
                algo = "sha512,rsa4096";
                key-name-hint = "dev";
                sign-images = "kernel", "fdt","ramdisk";
            };

        };
        fdt-ti_k3-am625-sancloud.dtb {
            description = "k3-am625-sancloud.dtb";
            data = /incbin/("./FIT_SourceFiles/k3-am625-sancloud.dtb");
            type = "flat_dt";
            arch = "arm64";
            os = "linux";
            compression = "none";
            hash-1 {
                algo = "sha512";
            };
            signature-1 {
                algo = "sha512,rsa4096";
                key-name-hint = "dev";
                sign-images = "kernel", "fdt","ramdisk";
            };

        };
        initrd {
            description = "Initrd";
            data = /incbin/("./FIT_SourceFiles/initrd.img");
            type = "ramdisk";
            arch = "arm64";
            os = "linux";
            hash-1 {
                algo = "sha512";
            };
            signature-1 {
                algo = "sha512,rsa4096";
                key-name-hint = "dev";
                sign-images = "kernel", "fdt","ramdisk";
            };

        };
    };
    configurations {
        default = "conf-ti_k3-am625-sancloud.dtb";
        conf-ti_k3-am625-sancloud.dtb{
            description = "LOAD DEBEIAN KERNEL";
            kernel = "kernel-1";
            fdt = "fdt-ti_k3-am625-sancloud.dtb";
            ramdisk = "initrd";
            signature-1 {
                algo = "sha512,rsa4096";
                key-name-hint = "dev";
                sign-images = "kernel", "fdt","ramdisk";
            };

        };
  
    };
};
```

## Sancloud-signed-Image/Secure-BOOT.its
```
/dts-v1/;

/ {
    description = "Beaglebone black";
    #address-cells = <1>;
    images {
        kernel-1 {
            description = "Image";
            data = /incbin/("./vmlinuz-@VERSION@");
            type = "kernel";
            arch = "arm64";
            os = "linux";
            load =  <0x82000000>;
            entry = <0x82000000>;
            compression = "gzip";
            hash-1 {
                algo = "sha512";
            };
            signature-1 {
                algo = "sha512,rsa4096";
                key-name-hint = "dev";
                sign-images = "kernel", "fdt";
            };

        };
        fdt-ti_k3-am625-sancloud.dtb {
            description = "k3-am625-sancloud.dtb";
            data = /incbin/("./k3-am625-sancloud.dtb");
            type = "flat_dt";
            arch = "arm64";
            os = "linux";
            compression = "none";
            load =<0x88000000>;
            hash-1 {
                algo = "sha512";
            };
            signature-1 {
                algo = "sha512,rsa4096";
                key-name-hint = "dev";
                sign-images = "kernel", "fdt";
            };

        };
    };
    configurations {
        default = "conf-ti_k3-am625-sancloud.dtb";
        conf-ti_k3-am625-sancloud.dtb{
            description = "LOAD DEBEIAN KERNEL";
            kernel = "kernel-1";
            fdt = "fdt-ti_k3-am625-sancloud.dtb";
            signature-1 {
                algo = "sha512,rsa4096";
                key-name-hint = "dev";
                sign-images = "kernel", "fdt";
            };

        };
  
    };
};
```

## Sancloud-signed-Image/Secure-FALLBACK.its
```
/dts-v1/;

/ {
    description = "Beaglebone black";
    #address-cells = <1>;
    images {
        kernel {
            description = "vmlinuz-@VERSION@";
            data = /incbin/("./vmlinuz-@VERSION@");
            type = "kernel";
            arch = "arm";
            os = "linux";
            load =  <0x89000000>;
            entry = <0x89000000>;
            compression = "none";
            hash{
                algo = "sha256";
            };
        };

        main_fdt {
            description = "am335x-sancloud-bbe-lite.dtb";
            data = /incbin/("./am335x-sancloud-bbe-lite.dtb");
            type = "flat_dt";
            arch = "arm";
            os = "linux";
            compression = "none";
            load =<0x88000000>;
            hash{
                algo = "sha256";
            };
        };
        fdt-ADC {
            description = "BB-ADC-00A0.dtbo";
            data = /incbin/("./BB-ADC-00A0.dtbo");
            type = "flat_dt";
            arch = "arm";
            os = "linux";
            compression = "none";
            load =<0x88f00000>;
            hash{
                algo = "sha256";
            };
        };
        fdt-eMMC1 {
            description = "BB-BONE-eMMC1-01-00A0.dtbo";
            data = /incbin/("./BB-BONE-eMMC1-01-00A0.dtbo");
            type = "flat_dt";
            arch = "arm";
            os = "linux";
            compression = "none";
            load =<0x88f00000>;
            hash{
                algo = "sha256";
            };
        };
        fdt-SPI {
            description = "BB-SPIDEV0-00A0.dtbo";
            data = /incbin/("./BB-SPIDEV0-00A0.dtbo");
            type = "flat_dt";
            os = "linux";
            arch = "arm";
            compression = "none";
            load =<0x88f00000>;
            hash{
                algo = "sha256";
            };
        };
        initrd {
            description = "Initrd";
            data = /incbin/("./initrd.img-@VERSION@");
            type = "ramdisk";
            arch = "arm";
            os = "linux";
            load =<0x88080000>;
            entry=<0x88080000>;
            compression = "none";
            hash{
                algo = "sha256";
            };
        };
    };
    configurations {
        default = "BOOT";
        BOOT{
            description = "BOOT Normal";
            kernel = "kernel";
            fdt = "main_fdt","fdt-ADC","fdt-SPI","fdt-eMMC1";
            ramdisk = "initrd";
            signature{
                algo = "sha256,rsa2048";
                key-name-hint = "conf";
                sign-images = "fdt","ramdisk";
            };

        };
    };
};
```

## Sancloud-signed-Image/sign.its
```
/dts-v1/;

/ {
    description = "Beaglebone black";
    #address-cells = <1>;
    images {
        kernel {
            description = "vmlinuz-5.10.168-ti-r79";
            data = /incbin/("./vmlinuz-5.10.168-ti-r79");
            type = "kernel";
            arch = "arm";
            os = "linux";
            load =  <0x89000000>;
            entry = <0x89000000>;
            compression = "none";
            hash-1 {
                algo = "sha256";
            };
            signature {
                algo = "sha256,rsa2048";
                key-name-hint = "dev";
            };
        };
        fdt-ligth {
            description = "am335x-sancloud-bbe-lite.dtb";
            data = /incbin/("./am335x-sancloud-bbe-lite.dtb");
            type = "flat_dt";
            arch = "arm";
            os = "linux";
            compression = "none";
            load =<0x88000000>;
            hash-1 {
                algo = "sha256";
            };
            signature {
                algo = "sha256,rsa2048";
                key-name-hint = "dev";
            };
        };
        fdt-ADC {
            description = "BB-ADC-00A0.dtbo";
            data = /incbin/("./BB-ADC-00A0.dtbo");
            type = "flat_dt";
            arch = "arm";
            os = "linux";
            compression = "none";
            load =<0x88f00000>;
            hash-1 {
                algo = "sha256";
            };
            signature {
                algo = "sha256,rsa2048";
                key-name-hint = "dev";
            };
        };
        fdt-eMMC1 {
            description = "BB-BONE-eMMC1-01-00A0.dtbo";
            data = /incbin/("./BB-BONE-eMMC1-01-00A0.dtbo");
            type = "flat_dt";
            arch = "arm";
            os = "linux";
            compression = "none";
            load =<0x88f00000>;
            hash-1 {
                algo = "sha256";
            };
            signature {
                algo = "sha256,rsa2048";
                key-name-hint = "dev";
            };
        };
        fdt-SPI {
            description = "BB-SPIDEV0-00A0.dtbo";
            data = /incbin/("./BB-SPIDEV0-00A0.dtbo");
            type = "flat_dt";
            os = "linux";
            arch = "arm";
            compression = "none";
            load =<0x88f00000>;
            hash-1 {
                algo = "sha256";
            };
            signature {
                algo = "sha256,rsa2048";
                key-name-hint = "dev";
            };

        };
        initrd {
            description = "Initrd";
            data = /incbin/("./initrd.img-5.10.168-ti-r79");
            type = "ramdisk";
            arch = "arm";
            os = "linux";
            load =<0x88080000>;
            entry=<0x88080000>;
            compression = "none";
            hash-1 {
                algo = "sha256";
            };
            signature {
                algo = "sha256,rsa2048";
                key-name-hint = "dev";
            };

        };
    };
    configurations {
        default = "r79";
        r79 {
            description = "";
            kernel = "kernel";
            fdt = "fdt-ligth","fdt-ADC","fdt-SPI","fdt-eMMC1";
            #ramdisk = "initrd";
            signature-1 {
                algo = "sha256,rsa2048";
                key-name-hint = "dev";
                sign-images = "fdt", "kernel";
            };
        };
    };
};
```
